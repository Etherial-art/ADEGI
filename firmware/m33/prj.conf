## CMakeLists.txt
```
cmake_minimum_required(VERSION 3.20.0)
find_package(Zephyr REQUIRED HINTS $ENV{ZEPHYR_BASE})
project(adegi_m33)

target_include_directories(app PRIVATE src)
target_sources(app PRIVATE
  src/main.c
  src/fsm.c
  src/drive.c
  src/protocol.c
  src/motor.c)

if(CONFIG_ADEGI_LINK_RPMSG)
  target_sources(app PRIVATE src/link_rpmsg.c)
else()
  target_sources(app PRIVATE src/link_stub.c)
endif()
```

## Kconfig
```
mainmenu "ADEGI M33 firmware"

config ADEGI_LINK_RPMSG
	bool "Real RPMsg link to the A35 (ipc_service + OpenAMP)"
	depends on IPC_SERVICE
	help
	  Needs an "ipc0" devicetree node (see boards/*.overlay.example).
	  When disabled, a scripted stub link is used instead.

config ADEGI_WHEEL_TRACK_MM
	int "Distance between drive wheels (mm)"
	default 180

config ADEGI_MAX_WHEEL_SPEED_MM_S
	int "Wheel speed that maps to 100% PWM (mm/s)"
	default 300

config ADEGI_VEL_TIMEOUT_MS
	int "Stop motors if no velocity command arrives within this time"
	default 500

config ADEGI_CONTROL_PERIOD_MS
	int "Control loop period (ms)"
	default 20

source "Kconfig.zephyr"
```

## west.yml
```
# West manifest for the ADEGI M33 firmware (see README.md for how to init).
manifest:
  remotes:
    - name: zephyrproject-rtos
      url-base: https://github.com/zephyrproject-rtos
  projects:
    - name: zephyr
      remote: zephyrproject-rtos
      # TODO(verify): pick the Zephyr release that ships the stm32mp257f_dk M33 board.
      revision: v4.2.0
      import:
        name-allowlist:
          - cmsis
          - hal_stm32
          - libmetal
          - open-amp
```

## prj.conf
```kconfig
CONFIG_LOG=y
CONFIG_PWM=y
CONFIG_GPIO=y
CONFIG_ASSERT=y
```

## rpmsg.conf
```kconfig
# Use with: west build ... -- -DEXTRA_CONF_FILE=rpmsg.conf
CONFIG_IPC_SERVICE=y
CONFIG_IPC_SERVICE_BACKEND_RPMSG=y
CONFIG_OPENAMP=y
CONFIG_ADEGI_LINK_RPMSG=y
```

## src/main.c
```c
/*
 * ADEGI M33 firmware: fixed-rate control loop.
 *
 *   link rx (ISR/thread) -> decode -> msgq -> [loop: FSM -> drive_mix -> motors]
 *                                                    \-> status back to the A35
 *
 * Events are queued instead of handled in the RPMsg callback so that all FSM
 * state is touched by exactly one thread (no locks needed).
 */
#include <zephyr/kernel.h>
#include <zephyr/logging/log.h>
#include "drive.h"
#include "fsm.h"
#include "link.h"
#include "motor.h"
#include "protocol.h"

LOG_MODULE_REGISTER(adegi, LOG_LEVEL_INF);

#define STATUS_PERIOD_MS 100

K_MSGQ_DEFINE(ev_q, sizeof(struct fsm_event), 16, 4);

static void on_rx(const uint8_t *data, size_t len)
{
	struct fsm_event ev;

	if (proto_decode(data, len, k_uptime_get_32(), &ev) != 0) {
		LOG_WRN("dropping malformed message (%u bytes)", (unsigned int)len);
		return;
	}
	if (k_msgq_put(&ev_q, &ev, K_NO_WAIT) != 0) {
		LOG_WRN("event queue full, message dropped");
	}
}

int main(void)
{
	struct fsm fsm;
	struct fsm_event ev;
	struct fsm_output out;
	int16_t left = 0, right = 0;
	uint32_t last_status = 0;

	fsm_init(&fsm);

	if (motor_init() != 0) {
		LOG_ERR("motor init failed; refusing to run");
		return -1;
	}
	if (link_init(on_rx) != 0) {
		/* Degrade gracefully: stay in IDLE, motors off. */
		LOG_ERR("link init failed; running without A35");
	}

	LOG_INF("ADEGI M33 up, state=%s", fsm_state_name(fsm.state));

	int64_t next = k_uptime_get();

	while (1) {
		bool changed = false;

		while (k_msgq_get(&ev_q, &ev, K_NO_WAIT) == 0) {
			enum adegi_state prev = fsm.state;

			if (fsm_handle(&fsm, &ev)) {
				changed = true;
				LOG_INF("state %s -> %s", fsm_state_name(prev),
					fsm_state_name(fsm.state));
			}
		}

		uint32_t now = k_uptime_get_32();

		fsm_output(&fsm, now, &out);
		drive_mix(out.v_mm_s, out.w_mrad_s, &left, &right);
		motor_set(left, right);

		if (changed || (uint32_t)(now - last_status) >= STATUS_PERIOD_MS) {
			uint8_t buf[PROTO_STATUS_LEN];
			uint8_t flags = (out.alert_active ? PROTO_FLAG_ALERT : 0) |
					(fsm.battery_low ? PROTO_FLAG_BATT_LOW : 0) |
					(out.vel_stale ? PROTO_FLAG_VEL_STALE : 0);
			size_t n = proto_encode_status(buf, sizeof(buf), fsm.state, flags,
						       left, right);

			(void)link_send(buf, n); /* -ENOTCONN before bind is expected */
			last_status = now;
		}

		next += CONFIG_ADEGI_CONTROL_PERIOD_MS;
		k_sleep(K_TIMEOUT_ABS_MS(next));
	}
	return 0;
}
```

## src/drive.c
```c
#include "drive.h"
#include <stdlib.h>

#ifndef CONFIG_ADEGI_WHEEL_TRACK_MM
#define CONFIG_ADEGI_WHEEL_TRACK_MM 180
#endif
#ifndef CONFIG_ADEGI_MAX_WHEEL_SPEED_MM_S
#define CONFIG_ADEGI_MAX_WHEEL_SPEED_MM_S 300
#endif

void drive_mix(int16_t v_mm_s, int16_t w_mrad_s, int16_t *left_pm, int16_t *right_pm)
{
	/* v_wheel = v -/+ w * (track / 2); mrad/s * mm / 1000 -> mm/s */
	int32_t dv = ((int32_t)w_mrad_s * CONFIG_ADEGI_WHEEL_TRACK_MM) / 2000;
	int32_t l = ((int32_t)v_mm_s - dv) * 1000 / CONFIG_ADEGI_MAX_WHEEL_SPEED_MM_S;
	int32_t r = ((int32_t)v_mm_s + dv) * 1000 / CONFIG_ADEGI_MAX_WHEEL_SPEED_MM_S;

	int32_t peak = abs(l) > abs(r) ? abs(l) : abs(r);

	if (peak > 1000) {
		l = l * 1000 / peak;
		r = r * 1000 / peak;
	}

	*left_pm = (int16_t)l;
	*right_pm = (int16_t)r;
}
```

## src/drive.h
```c
/* Differential-drive kinematics (pure C). */
#ifndef ADEGI_DRIVE_H
#define ADEGI_DRIVE_H

#include <stdint.h>

/*
 * Converts body velocity (v mm/s, w mrad/s) into signed wheel commands in
 * permille of full PWM (-1000..1000). If either wheel would exceed 100%,
 * both are scaled by the same factor so the commanded turning radius is kept
 * (clipping each wheel alone would silently change the trajectory).
 */
void drive_mix(int16_t v_mm_s, int16_t w_mrad_s, int16_t *left_pm, int16_t *right_pm);

#endif /* ADEGI_DRIVE_H */
```

## src/fsm.c
```c
#include "fsm.h"

#ifndef CONFIG_ADEGI_VEL_TIMEOUT_MS
#define CONFIG_ADEGI_VEL_TIMEOUT_MS 500
#endif

static bool is_moving_state(enum adegi_state s)
{
	return s == ST_ROAM || s == ST_FOLLOW || s == ST_RETURN_TO_DOCK;
}

static void enter(struct fsm *f, enum adegi_state s)
{
	f->state = s;
	/* Never inherit an old setpoint into a new state. */
	f->have_vel = false;
	f->v_mm_s = 0;
	f->w_mrad_s = 0;
}

void fsm_init(struct fsm *f)
{
	f->battery_low = false;
	enter(f, ST_IDLE);
	f->last_vel_ms = 0;
}

bool fsm_handle(struct fsm *f, const struct fsm_event *ev)
{
	enum adegi_state before = f->state;

	switch (ev->type) {
	case FSM_EV_ALERT:
		if (ev->flag) {
			if (f->state != ST_ALERT) {
				enter(f, ST_ALERT);
			}
		} else if (f->state == ST_ALERT) {
			enter(f, ST_IDLE);
		}
		break;

	case FSM_EV_MODE:
		/* Alert must be cleared explicitly; mode commands are ignored meanwhile. */
		if (f->state == ST_ALERT || ev->mode > ST_RETURN_TO_DOCK) {
			break;
		}
		if (f->battery_low && (ev->mode == ST_ROAM || ev->mode == ST_FOLLOW)) {
			/* Low battery: refuse to wander, go charge instead. */
			if (f->state != ST_CHARGING) {
				enter(f, ST_RETURN_TO_DOCK);
			}
			break;
		}
		if ((enum adegi_state)ev->mode != f->state) {
			enter(f, (enum adegi_state)ev->mode);
		}
		break;

	case FSM_EV_VELOCITY:
		if (is_moving_state(f->state)) {
			f->v_mm_s = ev->vel.v_mm_s;
			f->w_mrad_s = ev->vel.w_mrad_s;
			f->last_vel_ms = ev->now_ms;
			f->have_vel = true;
		}
		break;

	case FSM_EV_DOCK_CONTACT:
		if (ev->flag && f->state == ST_RETURN_TO_DOCK) {
			enter(f, ST_CHARGING);
		} else if (!ev->flag && f->state == ST_CHARGING) {
			/* Contact lost without a mode command: do not just sit there. */
			enter(f, f->battery_low ? ST_RETURN_TO_DOCK : ST_IDLE);
		}
		break;

	case FSM_EV_BATTERY_LOW:
		f->battery_low = ev->flag;
		if (ev->flag && (f->state == ST_ROAM || f->state == ST_FOLLOW ||
				 f->state == ST_IDLE)) {
			enter(f, ST_RETURN_TO_DOCK);
		}
		break;
	}

	return f->state != before;
}

void fsm_output(const struct fsm *f, uint32_t now_ms, struct fsm_output *out)
{
	out->v_mm_s = 0;
	out->w_mrad_s = 0;
	out->vel_stale = false;
	out->alert_active = (f->state == ST_ALERT);

	if (!is_moving_state(f->state)) {
		return;
	}

	/* Unsigned subtraction stays correct across uint32 wrap-around. */
	bool fresh = f->have_vel &&
		     (uint32_t)(now_ms - f->last_vel_ms) <= CONFIG_ADEGI_VEL_TIMEOUT_MS;

	if (fresh) {
		out->v_mm_s = f->v_mm_s;
		out->w_mrad_s = f->w_mrad_s;
	} else {
		out->vel_stale = true; /* dead-man: A35 crashed or link dropped */
	}
}

const char *fsm_state_name(enum adegi_state s)
{
	switch (s) {
	case ST_IDLE: return "idle";
	case ST_ROAM: return "roam";
	case ST_FOLLOW: return "follow";
	case ST_RETURN_TO_DOCK: return "return_to_dock";
	case ST_CHARGING: return "charging";
	case ST_ALERT: return "alert";
	}
	return "?";
}
```

## src/fsm.h
```c
/*
 * ADEGI behaviour state machine (low-level, runs on the M33).
 *
 * Pure C, no Zephyr dependencies, so it can be unit-tested on the host.
 * High-level decisions (where to go, whom to follow) live on the A35;
 * the M33 only enforces safe, deterministic state handling and drives motors.
 */
#ifndef ADEGI_FSM_H
#define ADEGI_FSM_H

#include <stdbool.h>
#include <stdint.h>

enum adegi_state {
	ST_IDLE = 0,
	ST_ROAM = 1,
	ST_FOLLOW = 2,
	ST_RETURN_TO_DOCK = 3,
	ST_CHARGING = 4,
	ST_ALERT = 5,
};

/* Values 0..3 are also the wire values of SET_MODE (see protocol.h). */

enum fsm_ev_type {
	FSM_EV_MODE,         /* .mode: requested adegi_state (IDLE/ROAM/FOLLOW/RETURN) */
	FSM_EV_VELOCITY,     /* .vel: body velocity setpoint from the A35 */
	FSM_EV_DOCK_CONTACT, /* .flag: charging contacts touching the dock */
	FSM_EV_ALERT,        /* .flag: true = fall/emergency, false = cleared */
	FSM_EV_BATTERY_LOW,  /* .flag */
};

struct fsm_event {
	enum fsm_ev_type type;
	uint32_t now_ms;
	union {
		uint8_t mode;
		bool flag;
		struct {
			int16_t v_mm_s;      /* forward speed */
			int16_t w_mrad_s;    /* yaw rate, positive = counter-clockwise */
		} vel;
	};
};

struct fsm_output {
	int16_t v_mm_s;
	int16_t w_mrad_s;
	bool alert_active;
	bool vel_stale;   /* moving state but setpoint missing/expired -> stopped */
};

struct fsm {
	enum adegi_state state;
	bool battery_low;
	bool have_vel;
	int16_t v_mm_s;
	int16_t w_mrad_s;
	uint32_t last_vel_ms;
};

void fsm_init(struct fsm *f);

/* Returns true if the state changed. */
bool fsm_handle(struct fsm *f, const struct fsm_event *ev);

/* Computes what the actuators should do right now. */
void fsm_output(const struct fsm *f, uint32_t now_ms, struct fsm_output *out);

const char *fsm_state_name(enum adegi_state s);

#endif /* ADEGI_FSM_H */
```

## src/link.h
```c
/* Transport to the A35. Implemented by link_rpmsg.c (real) or link_stub.c. */
#ifndef ADEGI_LINK_H
#define ADEGI_LINK_H

#include <stddef.h>
#include <stdint.h>

/* Called from the transport's context (ISR/thread): keep it short, no blocking. */
typedef void (*link_rx_cb)(const uint8_t *data, size_t len);

int link_init(link_rx_cb cb);

/* Returns 0 on success, negative errno otherwise (-ENOTCONN if peer not bound). */
int link_send(const uint8_t *data, size_t len);

#endif /* ADEGI_LINK_H */
```

## src/link_rpmsg.c
```c
/*
 * RPMsg link through Zephyr's ipc_service (OpenAMP backend).
 *
 * The A35 (Linux) is the RPMsg host; this firmware is the remote. Linux sees
 * a name-service announcement for "adegi-ctrl" and can open it as an rpmsg
 * char device. Requires an "ipc0" node (shared-memory region, IPM mailbox):
 * see boards/stm32mp257f_dk_stm32mp257xx_m33.overlay.example.
 */
#include <errno.h>
#include <zephyr/ipc/ipc_service.h>
#include <zephyr/kernel.h>
#include <zephyr/logging/log.h>
#include "link.h"

LOG_MODULE_REGISTER(link, LOG_LEVEL_INF);

static struct ipc_ept ept;
static link_rx_cb rx_cb;
static atomic_t bound;

static void ept_bound(void *priv)
{
	atomic_set(&bound, 1);
	LOG_INF("rpmsg endpoint bound");
}

static void ept_received(const void *data, size_t len, void *priv)
{
	if (rx_cb) {
		rx_cb(data, len);
	}
}

static struct ipc_ept_cfg ept_cfg = {
	.name = "adegi-ctrl",
	.cb = {
		.bound = ept_bound,
		.received = ept_received,
	},
};

int link_init(link_rx_cb cb)
{
	const struct device *ipc = DEVICE_DT_GET(DT_NODELABEL(ipc0));
	int ret;

	rx_cb = cb;
	ret = ipc_service_open_instance(ipc);
	if (ret < 0 && ret != -EALREADY) {
		LOG_ERR("ipc_service_open_instance: %d", ret);
		return ret;
	}
	ret = ipc_service_register_endpoint(ipc, &ept, &ept_cfg);
	if (ret < 0) {
		LOG_ERR("ipc_service_register_endpoint: %d", ret);
	}
	return ret;
}

int link_send(const uint8_t *data, size_t len)
{
	if (!atomic_get(&bound)) {
		return -ENOTCONN;
	}
	int ret = ipc_service_send(&ept, data, len);

	return ret < 0 ? ret : 0;
}
```

## src/link_stub.c
```c
/*
 * Stub link: replays a scripted conversation, as if the A35 were sending it,
 * and logs what the M33 would send back. Lets you watch the whole state
 * machine run on native_sim or on the board with no Linux side.
 */
#include <zephyr/kernel.h>
#include <zephyr/logging/log.h>
#include "link.h"

LOG_MODULE_REGISTER(link, LOG_LEVEL_INF);

struct step {
	uint32_t delay_ms;
	uint8_t len;
	uint8_t msg[5];
};

/* mode=roam, drive, battery low (-> return_to_dock), dock contact (-> charging),
 * mode=idle, fall alert, alert cleared. Velocity 150 mm/s, 0.5 rad/s. */
static const struct step script[] = {
	{1000, 2, {0x01, 0x01}},
	{200, 5, {0x02, 150, 0, 0xF4, 0x01}},
	{200, 5, {0x02, 150, 0, 0xF4, 0x01}},
	{1500, 2, {0x05, 0x01}},
	{200, 5, {0x02, 100, 0, 0, 0}},
	{1000, 2, {0x03, 0x01}},
	{2000, 2, {0x01, 0x00}},
	{1000, 2, {0x04, 0x01}},
	{2000, 2, {0x04, 0x00}},
};

static link_rx_cb rx_cb;

static void script_thread(void *a, void *b, void *c)
{
	for (size_t i = 0; i < ARRAY_SIZE(script); i++) {
		k_msleep(script[i].delay_ms);
		rx_cb(script[i].msg, script[i].len);
	}
	LOG_INF("stub script finished");
}

K_THREAD_STACK_DEFINE(script_stack, 1024);
static struct k_thread script_thr;

int link_init(link_rx_cb cb)
{
	rx_cb = cb;
	LOG_WRN("link: STUB (scripted A35 traffic, no RPMsg)");
	k_thread_create(&script_thr, script_stack, K_THREAD_STACK_SIZEOF(script_stack),
			script_thread, NULL, NULL, NULL, K_PRIO_PREEMPT(10), 0, K_NO_WAIT);
	return 0;
}

int link_send(const uint8_t *data, size_t len)
{
	LOG_DBG("tx %u bytes, type 0x%02x", (unsigned int)len, data[0]);
	return 0;
}
```

## src/motor.c
```c
/*
 * Motor driver for a DIR+PWM H-bridge per motor.
 *
 * The real path is compiled only when the board overlay defines, under
 * /zephyr,user:  pwms = <left>, <right>;  dir-gpios = <left>, <right>;
 * (see boards/stm32mp257f_dk_stm32mp257xx_m33.overlay.example).
 * Otherwise a stub just logs changes, so the app builds and runs anywhere
 * (including native_sim) before the power stage exists.
 */
#include <stdlib.h>
#include <zephyr/kernel.h>
#include <zephyr/logging/log.h>
#include "motor.h"

LOG_MODULE_REGISTER(motor, LOG_LEVEL_INF);

#define ZU DT_PATH(zephyr_user)

#if DT_NODE_HAS_PROP(ZU, pwms) && DT_NODE_HAS_PROP(ZU, dir_gpios)

#include <zephyr/drivers/gpio.h>
#include <zephyr/drivers/pwm.h>

static const struct pwm_dt_spec pwm[2] = {
	PWM_DT_SPEC_GET_BY_IDX(ZU, 0),
	PWM_DT_SPEC_GET_BY_IDX(ZU, 1),
};
static const struct gpio_dt_spec dir[2] = {
	GPIO_DT_SPEC_GET_BY_IDX(ZU, dir_gpios, 0),
	GPIO_DT_SPEC_GET_BY_IDX(ZU, dir_gpios, 1),
};

int motor_init(void)
{
	for (int i = 0; i < 2; i++) {
		if (!pwm_is_ready_dt(&pwm[i]) || !gpio_is_ready_dt(&dir[i])) {
			LOG_ERR("motor %d: PWM/GPIO device not ready", i);
			return -ENODEV;
		}
		int ret = gpio_pin_configure_dt(&dir[i], GPIO_OUTPUT_INACTIVE);

		if (ret < 0) {
			return ret;
		}
		/* Start stopped. */
		ret = pwm_set_dt(&pwm[i], pwm[i].period, 0);
		if (ret < 0) {
			return ret;
		}
	}
	LOG_INF("motors: real PWM driver");
	return 0;
}

static void set_one(int i, int16_t pm)
{
	uint32_t mag = (uint32_t)abs(pm);

	if (mag > 1000) {
		mag = 1000;
	}
	/* DIR pin active = forward. Flip a motor with GPIO_ACTIVE_LOW in the overlay. */
	gpio_pin_set_dt(&dir[i], pm >= 0);
	pwm_set_dt(&pwm[i], pwm[i].period, (uint32_t)(((uint64_t)pwm[i].period * mag) / 1000));
}

void motor_set(int16_t left_pm, int16_t right_pm)
{
	set_one(0, left_pm);
	set_one(1, right_pm);
}

#else /* ---- stub ---- */

static int16_t last_l, last_r;

int motor_init(void)
{
	LOG_WRN("motors: STUB (no pwms/dir-gpios in /zephyr,user)");
	return 0;
}

void motor_set(int16_t left_pm, int16_t right_pm)
{
	if (left_pm != last_l || right_pm != last_r) {
		LOG_INF("motor stub: L=%d R=%d (permille)", left_pm, right_pm);
		last_l = left_pm;
		last_r = right_pm;
	}
}

#endif
```

## src/motor.h
```c
/* Two-motor PWM driver. Real hardware if devicetree wires it, stub otherwise. */
#ifndef ADEGI_MOTOR_H
#define ADEGI_MOTOR_H

#include <stdint.h>

int motor_init(void);

/* Signed permille of full duty: -1000 (full reverse) .. +1000 (full forward). */
void motor_set(int16_t left_pm, int16_t right_pm);

#endif /* ADEGI_MOTOR_H */
```

## src/protocol.c
```c
#include "protocol.h"

#define PROTO_EINVAL (-22)

static int16_t rd_i16(const uint8_t *p)
{
	return (int16_t)((uint16_t)p[0] | ((uint16_t)p[1] << 8));
}

static void wr_i16(uint8_t *p, int16_t v)
{
	p[0] = (uint8_t)((uint16_t)v & 0xff);
	p[1] = (uint8_t)(((uint16_t)v >> 8) & 0xff);
}

int proto_decode(const uint8_t *buf, size_t len, uint32_t now_ms, struct fsm_event *ev)
{
	if (buf == NULL || ev == NULL || len < 1) {
		return PROTO_EINVAL;
	}

	ev->now_ms = now_ms;

	switch (buf[0]) {
	case PROTO_SET_MODE:
		if (len != 2 || buf[1] > ST_RETURN_TO_DOCK) {
			return PROTO_EINVAL;
		}
		ev->type = FSM_EV_MODE;
		ev->mode = buf[1];
		return 0;

	case PROTO_SET_VEL:
		if (len != 5) {
			return PROTO_EINVAL;
		}
		ev->type = FSM_EV_VELOCITY;
		ev->vel.v_mm_s = rd_i16(&buf[1]);
		ev->vel.w_mrad_s = rd_i16(&buf[3]);
		return 0;

	case PROTO_DOCK_CONTACT:
	case PROTO_ALERT:
	case PROTO_BATTERY_LOW:
		if (len != 2 || buf[1] > 1) {
			return PROTO_EINVAL;
		}
		ev->type = buf[0] == PROTO_DOCK_CONTACT ? FSM_EV_DOCK_CONTACT :
			   buf[0] == PROTO_ALERT ? FSM_EV_ALERT : FSM_EV_BATTERY_LOW;
		ev->flag = buf[1] != 0;
		return 0;

	default:
		return PROTO_EINVAL;
	}
}

size_t proto_encode_status(uint8_t *buf, size_t cap, uint8_t state, uint8_t flags,
			   int16_t left_pm, int16_t right_pm)
{
	if (cap < PROTO_STATUS_LEN) {
		return 0;
	}
	buf[0] = PROTO_STATUS;
	buf[1] = state;
	buf[2] = flags;
	wr_i16(&buf[3], left_pm);
	wr_i16(&buf[5], right_pm);
	return PROTO_STATUS_LEN;
}
```

## src/protocol.h
```c
/*
 * M33 <-> A35 wire protocol over the RPMsg endpoint "adegi-ctrl".
 *
 * Binary on purpose (CLAUDE.md allows it when real time requires): the
 * velocity setpoint is sent at ~50 Hz and the M33 should not run a JSON
 * parser in its control path. RPMsg preserves message boundaries, so no
 * length prefix is needed. All integers are little-endian.
 *
 *   A35 -> M33
 *     0x01 SET_MODE      u8 mode        0 idle, 1 roam, 2 follow, 3 return_to_dock
 *     0x02 SET_VEL       i16 v_mm_s, i16 w_mrad_s
 *     0x03 DOCK_CONTACT  u8 (0/1)
 *     0x04 ALERT         u8 (0/1)       1 = fall detected, 0 = cleared by family/app
 *     0x05 BATTERY_LOW   u8 (0/1)
 *   M33 -> A35
 *     0x81 STATUS        u8 state, u8 flags, i16 left_pm, i16 right_pm
 *                        flags: bit0 alert, bit1 battery_low, bit2 vel_stale
 *
 * Full description in docs/ (see firmware/m33/README.md).
 */
#ifndef ADEGI_PROTOCOL_H
#define ADEGI_PROTOCOL_H

#include <stddef.h>
#include <stdint.h>
#include "fsm.h"

#define PROTO_SET_MODE     0x01
#define PROTO_SET_VEL      0x02
#define PROTO_DOCK_CONTACT 0x03
#define PROTO_ALERT        0x04
#define PROTO_BATTERY_LOW  0x05
#define PROTO_STATUS       0x81

#define PROTO_STATUS_LEN   7

#define PROTO_FLAG_ALERT      (1u << 0)
#define PROTO_FLAG_BATT_LOW   (1u << 1)
#define PROTO_FLAG_VEL_STALE  (1u << 2)

/* 0 on success, negative errno-style value (-22 = bad message) otherwise. */
int proto_decode(const uint8_t *buf, size_t len, uint32_t now_ms, struct fsm_event *ev);

/* Returns bytes written, or 0 if cap is too small. */
size_t proto_encode_status(uint8_t *buf, size_t cap, uint8_t state, uint8_t flags,
			   int16_t left_pm, int16_t right_pm);

#endif /* ADEGI_PROTOCOL_H */
```
